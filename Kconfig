## Kconfig
```kconfig
#
# Copyright (c) 2022 Laird Connectivity LLC
#
# SPDX-License-Identifier: LicenseRef-LairdConnectivity-Clause
#
menuconfig LCZ_BLE_CLIENT_DM
	bool "LC BLE Client Device Manager"
	depends on LCZ_LWM2M_CLIENT
	depends on BT_PERIPHERAL

if LCZ_BLE_CLIENT_DM

module=LCZ_BLE_CLIENT_DM
module-str=LCZ_BLE_CLIENT_DM
source "subsys/logging/Kconfig.template.log_config"

config LCZ_BLE_CLIENT_DM_INIT_PRIORITY
	int "Init priority Application for BLE client device manager"
	range 0 99
	default APPLICATION_INIT_PRIORITY

config LCZ_BLE_CLIENT_DM_BLE_ADDR_INIT_PRIORITY
	int "BLE address init priority"
	range 0 99
	default APPLICATION_INIT_PRIORITY

config LCZ_BLE_CLIENT_DM_CLIENT_INDEX
	int "Client index for DM LwM2M connection"
	default 0

choice
	prompt "Init mode"
	default LCZ_BLE_CLIENT_DM_INIT_KCONFIG

config LCZ_BLE_CLIENT_DM_INIT_KCONFIG
	bool "Kconfig"
	help
	  Use Kconfig settings to init service.

config LCZ_BLE_CLIENT_DM_INIT_ATTRIBUTES
	bool "Attributes"
	depends on ATTR
	select LCZ_BLE_CLIENT_DM_ENABLE_ATTRIBUTES
	help
	  Use attributes system to init service.

endchoice

config LCZ_BLE_CLIENT_DM_ENABLE_ATTRIBUTES
	bool "Enable attributes"
	depends on ATTR
	help
	  Enable attributes system for settings.

if LCZ_BLE_CLIENT_DM_INIT_KCONFIG

config LCZ_BLE_CLIENT_DM_CONNECTION_DELAY
	int "DM connection delay"
	default 5
	help
	  Time in seconds to wait to start DM after power-up

endif # LCZ_BLE_CLIENT_DM_INIT_KCONFIG

config LCZ_BLE_CLIENT_DM_ADVERTISE
	bool "BLE Client Device Manager Advertisements"
	help
		When enabled, the client device manager will start BLE advertisements

if FSU_ENCRYPTED_FILES
config LCZ_CLIENT_DM_FILE_RULES_INIT_PRIORITY
	int "File rules callback init priority"
	range 0 99
	default APPLICATION_INIT_PRIORITY
	help
	  Application init priority for file management rule callback registration
endif # FSU_ENCRYPTED_FILES

if MCUMGR
config LCZ_CLIENT_DM_SMP_RULES_INIT_PRIORITY
	int "SMP rules callback init priority"
	range 0 99
	default APPLICATION_INIT_PRIORITY
	help
	  Application init priority for SMP permission callback registration

config LCZ_CLIENT_DM_SMP_AUTH_TIMEOUT
	int "SMP authorization timeout (in secconds)"
	range 0 86400
	default 300
	help
	  After a period of inactivity specified by this value, an SMP authorization will expire.
	  This value is used only a backup to the similarly-named attribute.
endif # MCUMGR

endif # LCZ_BLE_CLIENT_DM
```
